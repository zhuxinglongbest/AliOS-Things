## app/example/sal_simple_test/Config.in
```kconfig
config AOS_APP_SAL_SIMPLE_TEST
    bool "sal simple test"
    select AOS_COMP_YLOOP
    help

if AOS_APP_SAL_SIMPLE_TEST
# Configurations for sal simple test
endif
```

## drivers/Config.in
```kconfig
menu "Drivers     Configuration"

source "drivers/sensor/Config.in"

if AOS_COMP_SAL
choice
    prompt "SAL Drivers Configuration"
    default AOS_SAL_WIFI if BSP_EXTERNAL_WIFI_MODULE != ""
    default AOS_SAL_NBIOT if BSP_EXTERNAL_NBIOT_MODULE != ""

    source "drivers/sal/gprs/Config.in"
    source "drivers/sal/wifi/Config.in"
    source "drivers/sal/nbiot/Config.in"
endchoice
endif

endmenu
```

## drivers/sal/nbiot/Config.in
```kconfig
config AOS_SAL_NBIOT
    bool "NBIOT"

if AOS_SAL_NBIOT

choice
    prompt "Device"
    default AOS_COMP_DEVICE_SAL_M5310A if BSP_EXTERNAL_NBIOT_MODULE = "nbiot.m5310a"

config AOS_NBIOT_NULL
    bool "Null"

source "drivers/sal/nbiot/m5310a/Config.in"

endchoice

endif
```
